// Door relay controller for ESP32 (Arduino core 2.x) + esp32_https_server by fhessel.
// UNTESTED ON HARDWARE. Protocol: docs/DESIGN.md. Build only after reading the safety notes there.
#include <WiFi.h>
#include <HTTPSServer.hpp>
#include <SSLCert.hpp>
#include <HTTPRequest.hpp>
#include <HTTPResponse.hpp>
#include <mbedtls/md.h>
#include "secrets.h"  // generated by tools/gen_secrets.sh: WIFI_SSID, WIFI_PASS, HMAC_SECRET[32], CERT_DER[], KEY_DER[]

using namespace httpsserver;

constexpr int RELAY_PIN = 26;
constexpr bool RELAY_ACTIVE_HIGH = true;     // set false for active-low relay boards
constexpr int DOOR_PIN = -1;                 // GPIO of a reed switch to GND (closed to GND = door shut), or -1 if none
constexpr uint32_t PULSE_MS = 1000;          // contact closure time across the terminal's BUT and GND
constexpr uint32_t NONCE_TTL_MS = 10000;
constexpr uint32_t LOCKOUT_MS = 60000;
constexpr int MAX_FAILS = 5;
constexpr int NONCE_SLOTS = 4;

struct Nonce { uint8_t v[16]; uint32_t born; bool used; };
Nonce nonces[NONCE_SLOTS];
int fails = 0;
uint32_t lockedUntil = 0;
uint32_t pulseEnd = 0;
bool pulsing = false;

SSLCert cert(CERT_DER, sizeof(CERT_DER), KEY_DER, sizeof(KEY_DER));
HTTPSServer server(&cert, 8443, 2);

void relaySet(bool on) { digitalWrite(RELAY_PIN, (on == RELAY_ACTIVE_HIGH) ? HIGH : LOW); }

const char* doorState() {
  if (DOOR_PIN < 0) return "none";
  return digitalRead(DOOR_PIN) == LOW ? "closed" : "open";
}

String toHex(const uint8_t* b, size_t n) {
  static const char* d = "0123456789abcdef"; String s; s.reserve(n * 2);
  for (size_t i = 0; i < n; i++) { s += d[b[i] >> 4]; s += d[b[i] & 15]; }
  return s;
}

bool nibble(char c, uint8_t& o) {
  if (c >= '0' && c <= '9') o = c - '0'; else if (c >= 'a' && c <= 'f') o = c - 'a' + 10; else if (c >= 'A' && c <= 'F') o = c - 'A' + 10; else return false;
  return true;
}

bool fromHex(const std::string& s, uint8_t* out, size_t n) {
  if (s.size() != n * 2) return false;
  for (size_t i = 0; i < n; i++) { uint8_t h, l; if (!nibble(s[2 * i], h) || !nibble(s[2 * i + 1], l)) return false; out[i] = (h << 4) | l; }
  return true;
}

bool constEq(const uint8_t* a, const uint8_t* b, size_t n) { uint8_t r = 0; for (size_t i = 0; i < n; i++) r |= a[i] ^ b[i]; return r == 0; }

void json(HTTPResponse* res, int code, const String& body) {
  res->setStatusCode(code); res->setHeader("Content-Type", "application/json"); res->setHeader("Cache-Control", "no-store"); res->print(body.c_str());
}

void handleChallenge(HTTPRequest*, HTTPResponse* res) {
  uint32_t now = millis();
  if ((int32_t)(lockedUntil - now) > 0) { json(res, 429, "{\"error\":\"locked\"}"); return; }
  int slot = 0; uint32_t oldest = UINT32_MAX;
  for (int i = 0; i < NONCE_SLOTS; i++) { if (nonces[i].used || nonces[i].born == 0) { slot = i; break; } if (nonces[i].born < oldest) { oldest = nonces[i].born; slot = i; } }
  esp_fill_random(nonces[slot].v, 16); nonces[slot].born = now ? now : 1; nonces[slot].used = false;
  json(res, 200, "{\"nonce\":\"" + toHex(nonces[slot].v, 16) + "\"}");
}

void handleStatus(HTTPRequest*, HTTPResponse* res) {
  json(res, 200, String("{\"relay\":\"") + (pulsing ? "active" : "idle") + "\",\"door\":\"" + doorState() + "\",\"fw\":\"1.0\"}");
}

void handleUnlock(HTTPRequest* req, HTTPResponse* res) {
  uint32_t now = millis();
  if ((int32_t)(lockedUntil - now) > 0) { json(res, 429, "{\"error\":\"locked\"}"); return; }
  ResourceParameters* p = req->getParams();
  std::string nonceHex, macHex; uint8_t nonce[16], mac[32];
  if (!p->getQueryParameter("nonce", nonceHex) || !p->getQueryParameter("mac", macHex) || !fromHex(nonceHex, nonce, 16) || !fromHex(macHex, mac, 32)) { json(res, 400, "{\"error\":\"bad request\"}"); return; }
  int slot = -1;
  for (int i = 0; i < NONCE_SLOTS; i++) if (!nonces[i].used && nonces[i].born && constEq(nonces[i].v, nonce, 16)) slot = i;
  if (slot < 0 || now - nonces[slot].born > NONCE_TTL_MS) { json(res, 409, "{\"error\":\"nonce\"}"); return; }
  nonces[slot].used = true;  // single use, consumed whether or not the MAC is right

  String msg = "unlock|" + String(nonceHex.c_str());
  uint8_t expect[32];
  mbedtls_md_hmac(mbedtls_md_info_from_type(MBEDTLS_MD_SHA256), HMAC_SECRET, 32, (const uint8_t*)msg.c_str(), msg.length(), expect);
  if (!constEq(expect, mac, 32)) {
    if (++fails >= MAX_FAILS) { lockedUntil = now + LOCKOUT_MS; fails = 0; }
    json(res, 401, "{\"error\":\"auth\"}"); return;
  }
  fails = 0;
  relaySet(true); pulsing = true; pulseEnd = now + PULSE_MS;
  json(res, 200, String("{\"accepted\":true,\"relay\":\"active\",\"door\":\"") + doorState() + "\"}");
}

void setup() {
  digitalWrite(RELAY_PIN, RELAY_ACTIVE_HIGH ? LOW : HIGH);  // de-energised before the pin becomes an output
  pinMode(RELAY_PIN, OUTPUT);
  if (DOOR_PIN >= 0) pinMode(DOOR_PIN, INPUT_PULLUP);
  Serial.begin(115200);
  WiFi.mode(WIFI_STA); WiFi.begin(WIFI_SSID, WIFI_PASS);
  while (WiFi.status() != WL_CONNECTED) delay(250);
  Serial.println(WiFi.localIP());
  server.registerNode(new ResourceNode("/challenge", "GET", &handleChallenge));
  server.registerNode(new ResourceNode("/status", "GET", &handleStatus));
  server.registerNode(new ResourceNode("/unlock", "POST", &handleUnlock));
  server.start();
}

void loop() {
  server.loop();
  if (pulsing && (int32_t)(millis() - pulseEnd) >= 0) { relaySet(false); pulsing = false; }
  if (WiFi.status() != WL_CONNECTED) { WiFi.reconnect(); delay(1000); }
}
